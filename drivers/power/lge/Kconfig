## drivers/power/lge/Kconfig
```kconfig
config LGE_PM_BATTERY_VENEER
	bool "Apply LGE battery veneer"
	default n
	help
	  Say Y here enable support lge battery veneer
```

## drivers/soc/qcom/lge/power/Kconfig
```kconfig
config LGE_PM_LGE_POWER_CORE
	bool "Apply LGE Power Core"
	default n
	help
	  Say Y here enable support lge power core

config LGE_PM_LGE_POWER_CLASS_CHARGING_CONTROLLER
	tristate "LGE charging controller driver for LG Power Class"
	depends on LGE_PM_LGE_POWER_CORE
	default n
	help
	  Say Y here enable support charging controller for LG Power Class

config LGE_PM_LGE_POWER_CLASS_BATTERY_ID_CHECKER
	tristate "Battery ID checker driver for LG Power Class"
	depends on LGE_PM_LGE_POWER_CORE
	default n
	help
	  Say Y here enable support battery id checker driver for LG Power Class
```

## drivers/usb/misc/tusb422/Kconfig
```kconfig
config TUSB422
	bool "Enable TUSB422 USB Power Delivery"
	default n

config TUSB422_PAL
	bool "Enable TUSB422 Platform Abstraction Layer"
	default n
	depends on TUSB422

config USB_TUSB422
	bool "Enable TUSB422 USB Power Delivery"
	select TUSB422

config USB_TUSB422_PAL
	bool "Enable TUSB422 Platform Abstraction Layer"
	depends on USB_TUSB422
	select TUSB422_PAL
```
